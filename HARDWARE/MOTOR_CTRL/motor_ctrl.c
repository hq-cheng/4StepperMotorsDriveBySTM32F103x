/*
 *
 *  Copyright 2018，程豪琪，哈尔滨工业大学
 *  All Rights Reserved.
 */
/*
 * *******************************郑重声明****************************************
 
 * 该程序为本人所写，付出了大量的精力，现将其公开出来供大家参考学习；
 * 任何个人和组织不得未经授权将此程序转载，或用于商业行为！
 * 
 * 由于本人水平有限，程序难免出现错误，可以通过下面的联系方式联系本人
 * 谢谢你的指正！
 *
 * 邮箱：18s153717@stu.hit.edu.cn
 * github：https://github.com/clearcumt
 * 博客：https://www.cnblogs.com/loveclear/
 * 
 * ******************************************************************************
 */
 
#include "motor_ctrl.h"


const uint16_t Svalue_length = 432;
/*- S型加减速曲线，PWM输出频率表（修改psc值以改变频率） -*/ 
const uint16_t AccSvalue[Svalue_length]=
{
	504, 503, 503, 502, 501, 501, 500, 499, 499, 498, 497, 497, 496, 495, 494, 494, 
	493, 492, 491, 490, 490, 489, 488, 487, 486, 485, 484, 483, 483, 482, 481, 480, 
	479, 478, 477, 476, 475, 474, 473, 472, 470, 469, 468, 467, 466, 465, 464, 463, 
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	110, 110, 110, 110, 110, 110, 110, 110, 110, 110, 110, 110, 110, 110, 110, 110 
};

const uint16_t DecSvalue[Svalue_length]=
{
	110, 110, 110, 110, 110, 110, 110, 110, 110, 110, 110, 110, 110, 110, 110, 110, 
	110, 110, 110, 110, 110, 110, 110, 110, 110, 111, 111, 111, 111, 111, 111, 111, 
	111, 111, 111, 111, 111, 111, 111, 111, 111, 111, 111, 112, 112, 112, 112, 112, 
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	494, 494, 495, 496, 497, 497, 498, 499, 499, 500, 501, 501, 502, 503, 503, 504 
};

/*******************************************************************************
* 函 数 名         : TIM_OCENSet
* 函数功能         : 打开（ENABLE）/关闭（DISABLE）pwm脉冲/比较输出通道
* 输    入         : TIMx OCx_ENR
* 输    出         : 无
*******************************************************************************/
void TIM_OCENSet(TIM_TypeDef* MOTOx, uint16_t OCx_ENR,FunctionalState NewState)
{
	assert_param(IS_TIM_LIST6_PERIPH(MOTOx));
	if(NewState == ENABLE)
	{
		MOTOx->CCER |= 0x0001 << OCx_ENR;
	}
	if(NewState == DISABLE)
	{
		MOTOx->CCER &= 0xFFFE << OCx_ENR;
	}
}

/*******************************************************************************
* 函 数 名         : Set_Motor_EN
* 函数功能         : XYZ三轴中，单个电机运行使能设置
* 输    入         : MOTOx（可以是MOTOX,MOTOY,MOTOZ），
					 NewState（电机使能设置，ENABLE使能,DISABLE关闭）
* 输    出         : 无
*******************************************************************************/
void Set_Motor_EN(TIM_TypeDef* MOTOx,FunctionalState NewState)
{
	u16 Ena = 0;
	assert_param(IS_TIM_LIST6_PERIPH(MOTOx));
	
	if(NewState == ENABLE)
	{
		Ena = 1;
	}
	
	switch(Ena)
	{
		case 1:
			if(MOTOx == TIM2)GPIO_ResetBits(GPIOC,MotorX_ENABLE);		// 低电平使能
			if(MOTOx == TIM3)GPIO_ResetBits(GPIOC,MotorY_ENABLE);
			if(MOTOx == TIM4)GPIO_ResetBits(GPIOC,MotorZ_ENABLE);		
			break;
		case 0:
			if(MOTOx == TIM2)GPIO_SetBits(GPIOC,MotorX_ENABLE);
			if(MOTOx == TIM3)GPIO_SetBits(GPIOC,MotorY_ENABLE);
			if(MOTOx == TIM4)GPIO_SetBits(GPIOC,MotorZ_ENABLE);
			break;
	}
}

/*******************************************************************************
* 函 数 名         : Set_Motor_Dir
* 函数功能         : XYZ三轴中，单个电机运行方向设置
* 输    入         : MOTOx（可以是MOTOX,MOTOY,MOTOZ），
					 Dir（电机的转动反向）
* 输    出         : 无
*******************************************************************************/
void Set_Motor_Dir(TIM_TypeDef* MOTOx,unsigned char Dir)
{
	switch(Dir)
	{
		case FORWARD:
			if(MOTOx == TIM2)MotorX_DIR_Bit = 1;
			if(MOTOx == TIM3)MotorY_DIR_Bit = 1;
			if(MOTOx == TIM4)MotorZ_DIR_Bit = 1;		
			break;
		case REVERSE:
			if(MOTOx == TIM2)MotorX_DIR_Bit = 0;
			if(MOTOx == TIM3)MotorY_DIR_Bit = 0;
			if(MOTOx == TIM4)MotorZ_DIR_Bit = 0;
			break;
	}
	
}

/*******************************************************************************
* 函 数 名         : Set_Motor_Speed
* 函数功能         : 修改定时器的预分频值，用以改变定时器pwm的频率,以改变电机速度
* 输    入         : 	MOTOx（可以是MOTOX,MOTOY,MOTOZ）
						psc(预分频值)
* 输    出         : 无
*******************************************************************************/
void Set_Motor_Speed(TIM_TypeDef* MOTOx,uint16_t psc)
{
	// 也可以使用TIM_SetAutoreload(TIM_TypeDef* TIMx, uint16_t Autoreload)修改ARR的值
	assert_param(IS_TIM_ALL_PERIPH(MOTOx));
	MOTOx->PSC = psc-1;
}

/*******************************************************************************
* 函 数 名         : Start_Motor_withS
* 函数功能         : XYZ三轴中，单个电机伴随S曲线加速启动程序
* 输    入         : MOTOx（可以是MOTOX,MOTOY,MOTOZ）
					 Dir（电机的转动反向）
* 输    出         : 无
*******************************************************************************/
void Start_Motor_withS(TIM_TypeDef* MOTOx, unsigned char Dir)
{
	int i;
	assert_param(IS_TIM_LIST6_PERIPH(MOTOx));
	Set_Motor_Dir(MOTOx, Dir);
	TIM_OCENSet(MOTOx, OC2_ENR, ENABLE);	// 默认初始化关闭比较输出使能，这里打开比较输出使能，保证电机运行
	
	// 改变电机结构体相关参数,运行状态
	if(MOTOx == MOTOX)motor1.running = Get_Motor_RunningState(MOTOx);
	if(MOTOx == MOTOY)motor2.running = Get_Motor_RunningState(MOTOx);
	if(MOTOx == MOTOZ)motor3.running = Get_Motor_RunningState(MOTOx);
	
	for(i=0;i<Svalue_length;i++)
	{
		Set_Motor_Speed(MOTOx,AccSvalue[i]);	// 加速到一定转速后运行
		delay_ms(1);
	}
}

/*******************************************************************************
* 函 数 名         : Stop_Motor_withS
* 函数功能         : XYZ三轴中，单个电机伴随S曲线减速停止程序
* 输    入         : MOTOx（可以是MOTOX,MOTOY,MOTOZ）
* 输    出         : 无
*******************************************************************************/
void Stop_Motor_withS(TIM_TypeDef* MOTOx)
{
	int i;
	assert_param(IS_TIM_LIST6_PERIPH(MOTOx));
	// 其实应该获取当前的psc值，来获取当前的速度
	// 然后实时调整加减速S曲线表格
	// 这里假定运行速度为500rpm，运行过程不会改变速度
	for(i=0;i<Svalue_length;i++)
	{
		Set_Motor_Speed(MOTOx,DecSvalue[i]);
		delay_ms(1);
	}
	
	MOTOx->CCER &= 0xFFFE << OC2_ENR;		
	TIM_OCENSet(MOTOx, OC2_ENR, DISABLE);	// 减速到一定转速后停止电机
	
	// 改变电机结构体相关参数,运行状态
	if(MOTOx == MOTOX)motor1.running = Get_Motor_RunningState(MOTOx);
	if(MOTOx == MOTOY)motor2.running = Get_Motor_RunningState(MOTOx);
	if(MOTOx == MOTOZ)motor3.running = Get_Motor_RunningState(MOTOx);
}

/*******************************************************************************
* 函 数 名         : Set_Motor_Dir
* 函数功能         : XYZ三轴中，改变单个电机运行方向（与电机方向设置函数不同）
* 输    入         : MOTOx（可以是MOTOX,MOTOY,MOTOZ），
					 Dir（电机的转动反向）
* 输    出         : 无
*******************************************************************************/
void Change_Motor_Dir(TIM_TypeDef* MOTOx,unsigned char Dir)
{
	assert_param(IS_TIM_LIST6_PERIPH(MOTOx));
	
	if(Get_Motor_RunningState(MOTOx) == RUNNING )
	{
		Stop_Motor_withS(MOTOx);
		Start_Motor_withS(MOTOx, Dir);
	}
	if(Get_Motor_RunningState(MOTOx) == STOPPING)
	{
		Set_Motor_Dir(MOTOx, Dir);
	}
	
}



/*******************************************************************************
* 函 数 名         : Stop_Motor_withS
* 函数功能         : XYZ三轴中，获取单个电机当前运行状态
* 输    入         : MOTOx（可以是MOTOX,MOTOY,MOTOZ）
* 输    出         : runing_state(1/runnning, 0/not running)
*******************************************************************************/
uint16_t Get_Motor_RunningState(TIM_TypeDef* MOTOx)
{
	uint16_t runing_state, running;
	assert_param(IS_TIM_LIST6_PERIPH(MOTOx));
	running = 0x0001<<OC2_ENR;
	runing_state = MOTOx->CCER & running;
	if(runing_state == running)
		return runing_state = 1;
	else	
		return runing_state = 0;
}

/*******************************************************************************
* 函 数 名         : Get_Motor_RunningSpeed
* 函数功能         : XYZ三轴中，获取单个电机当前运行速度
* 输    入         : MOTOx（可以是MOTOX,MOTOY,MOTOZ）
* 输    出         : psc(0/速度为0)
*******************************************************************************/
uint16_t Get_Motor_RunningSpeed(TIM_TypeDef* MOTOx)
{
	assert_param(IS_TIM_LIST6_PERIPH(MOTOx));
	if(Get_Motor_RunningState(MOTOx) == RUNNING)
		return MOTOx->PSC + 1;
	else	
		return 0;
}

/*******************************************************************************
* 函 数 名         : Annex_Seal_By
* 函数功能         : 启动Z轴电机执行盖章动作（分为：按下印章 Dir = 1，抬起印章 Dir = 1）
* 输    入         : 无 
* 输    出         : 无
*******************************************************************************/

void Annex_Seal_By(TIM_TypeDef* MOTOx, unsigned char Dir)
{
	Start_Motor_withS(MOTOx,Dir);
	delay_s(1);
	Stop_Motor_withS(MOTOx);
}


